## conf/layer.conf
```bitbake
# We have a conf and classes directory, add to BBPATH
BBPATH .= ":${LAYERDIR}"

# We have recipes-* directories, add to BBFILES
BBFILES += "${LAYERDIR}/recipes-*/*/*.bb \
            ${LAYERDIR}/recipes-*/*/*.bbappend"

BBFILE_COLLECTIONS += "meta-scicalc"
BBFILE_PATTERN_meta-scicalc = "^${LAYERDIR}/"
BBFILE_PRIORITY_meta-scicalc = "6"

LAYERDEPENDS_meta-scicalc = "core"
LAYERSERIES_COMPAT_meta-scicalc = "dunfell"
```
